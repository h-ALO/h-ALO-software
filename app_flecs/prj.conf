## CMakeLists.txt
```
#-------------------------------------------------------------------------------
# Zephyr Example Application
#
# Copyright (c) 2021 Nordic Semiconductor ASA
# SPDX-License-Identifier: Apache-2.0

cmake_minimum_required(VERSION 3.13.1)
find_package(Zephyr REQUIRED HINTS $ENV{ZEPHYR_BASE})

project(app LANGUAGES C VERSION 1.0.0)

configure_file(app_version.h.in ${CMAKE_BINARY_DIR}/app/include/app_version.h)
target_include_directories(app PRIVATE ${CMAKE_BINARY_DIR}/app/include src)

target_sources(app PRIVATE src/main.c)

#FILE(GLOB app_sources src/*.c)
FILE(GLOB app_sources src/egadc.c src/MCP356X.c)
FILE(GLOB app_sources src/egadc.c src/flecs.c)

target_sources(app PRIVATE ${app_sources})
```

## prj.conf
```kconfig
# Copyright (c) 2021 Nordic Semiconductor ASA
# SPDX-License-Identifier: Apache-2.0
#
# This file contains selected Kconfig options for the application.


#CONFIG_BT=y
#CONFIG_BT_PERIPHERAL=y
#CONFIG_BT_SMP=y
#CONFIG_TINYCRYPT=y
#CONFIG_BT_DEVICE_NAME="TIABT"
#CONFIG_BT_DIS=y
#CONFIG_BT_DIS_PNP=n
#CONFIG_BT_BAS=y
#CONFIG_BT_DEVICE_APPEARANCE=0
#CONFIG_BT_DEBUG_LOG=y
#CONFIG_BT_GATT_CLIENT=y


#CONFIG_BT_MESH_ADV_STACK_SIZE=2048
#CONFIG_BT_RX_STACK_SIZE=4096
#CONFIG_MAIN_STACK_SIZE=2048


#CONFIG_SENSOR=y
#CONFIG_SPI_INIT_PRIORITY=70
#CONFIG_ADC_INIT_PRIORITY=71
CONFIG_SPI=y
#CONFIG_ADC=y



CONFIG_PRINTK=y
CONFIG_LOG=y
CONFIG_LOG_BUFFER_SIZE=2048
CONFIG_NEWLIB_LIBC=y
CONFIG_POSIX_API=y

# This causes ***** MPU FAULT ***** when bluetooth is connecting
CONFIG_LOG_MODE_IMMEDIATE=y 
```

## src/main.c
```c
/*
west build -b nucleo_wb55rg

*** Booting Zephyr OS build zephyr-v3.3.0-1017-g1545f9ba7f33 ***
[00:00:00.005,000] <ESC>[0m<inf> main: Zephyr Example Application /soc/spi@40013000/examplesensor@0<ESC>[0m
*** Booting Zephyr OS build zephyr-v3.3.0-1928-g0e6c306dcec9 ***
[00:00:00.005,000] <ESC>[0m<inf> main: Zephyr Example Application /soc/spi@40013000/examplesensor@0<ESC>[0m
[00:00:00.014,000] <ESC>[0m<inf> adc_mcp356x: Setting registers in MCP356X<ESC>[0m
[00:00:00.021,000] <ESC>[0m<inf> adc_mcp356x: Register set: MCP356X_REG_LOCK        : 000000a5 00000000<ESC>[0m
[00:00:00.030,000] <ESC>[0m<inf> adc_mcp356x: Register set: MCP356X_REG_CFG_0       : 00000023 00000000<ESC>[0m




*** Booting Zephyr OS build zephyr-v3.3.0-1928-g0e6c306dcec9 ***
*** Booting Zephyr OS build zephyr-v3.3.0-1928-g0e6c306dcec9 ***
*** Booting Zephyr OS build zephyr-v3.3.0-2655-g9e105d203766 ***



*/

#include <zephyr/kernel.h>
#include <zephyr/drivers/sensor.h>
#include <zephyr/drivers/spi.h>
#include <stdint.h>

#include "app_version.h"
#include "egadc.h"
#include "bt.h"

#include <zephyr/logging/log.h>
LOG_MODULE_REGISTER(main, CONFIG_APP_LOG_LEVEL);
//struct spi_dt_spec bus = SPI_DT_SPEC_GET(DT_NODELABEL(mcp3204), SPI_WORD_SET(8) | SPI_MODE_GET(0), 1);


// The ADC9 uses 2000mV voltage ref chip MCP1501
#define ADC9_VREF 2048
#define TIABT_VREF 3000





void app_print_voltage_ref(struct mcp356x_config * c)
{
	LOG_INF("Checking voltage reference:");
	egadc_adc_value_reset(c);
	egadc_set_mux(c, MCP356X_MUX_VIN_NEG_AGND | MCP356X_MUX_VIN_POS_VREF_EXT_PLUS);
	int n = 10;
	while (n--)
	{
		printk("IRQ:%-4i DRDY:%-4i avg:%-8i min:%-8i max:%-8i\n", c->num_irq, c->num_drdy, c->mv_iir[MCP356X_CH_CH0], c->mv_min[MCP356X_CH_CH0], c->mv_max[MCP356X_CH_CH0]);
		egadc_adc_value_reset(c);
		k_sleep(K_MSEC(1000));
	}
}



enum app_state
{
	APP_START,
	APP_WAITING,
	APP_INIT_ADC,
	APP_PRINT_ADC
};



struct mcp356x_config c = 
{
	.bus = SPI_DT_SPEC_GET(DT_NODELABEL(examplesensor0), SPI_WORD_SET(8) | SPI_MODE_GET(0), 1),
	.irq = GPIO_DT_SPEC_GET(DT_NODELABEL(examplesensor0), irq_gpios),
	.is_scan = false,
	.gain_reg = MCP356X_CFG_2_GAIN_X_033,
	.vref_mv = TIABT_VREF
};




void main(void)
{
	LOG_INF("Zephyr Example Application %s", "" DT_NODE_PATH(DT_NODELABEL(examplesensor0)));

	if (!spi_is_ready_dt(&c.bus))
	{
		LOG_ERR("SPI bus is not ready %i", 0);
		return;
	}

	//mybt_init();
	//while (1){k_sleep(K_MSEC(5000));}


	while(0)
	{
		LOG_INF("1");
		k_sleep(K_MSEC(1000));
	}


	int appstate = APP_START;
	while (1)
	{
		if(c.status & EGADC_TIMEOUT_BIT)
		{
			appstate = APP_INIT_ADC;
			c.status &= ~EGADC_TIMEOUT_BIT;
		}


		switch (appstate)
		{
		case APP_WAITING:
			LOG_INF("APP_WAITING");
			if(c.status & EGADC_THREAD_STARTED_BIT)
			{
				app_print_voltage_ref(&c);
				egadc_set_mux(&c, MCP356X_MUX_VIN_NEG_AGND | MCP356X_MUX_VIN_POS_CH5);
				//egadc_set_mux(&c, MCP356X_MUX_VIN_NEG_AGND | MCP356X_MUX_VIN_POS_CH0);
				appstate = APP_PRINT_ADC;
			}
			break;

		case APP_START:
			LOG_INF("APP_START");
			egadc_setup_board(&c);
			appstate = APP_INIT_ADC;
			break;

		case APP_INIT_ADC:
			LOG_INF("APP_INIT_ADC");
			egadc_setup_adc(&c);
			appstate = APP_WAITING;
			break;

		case APP_PRINT_ADC:
			printk("IRQ:%-4i DRDY:%-4i avg:%-8i min:%-8i max:%-8i\n", c.num_irq, c.num_drdy, c.mv_iir[MCP356X_CH_CH0], c.mv_min[MCP356X_CH_CH0], c.mv_max[MCP356X_CH_CH0]);
			egadc_adc_value_reset(&c);
			break;

		default:
			break;
		}




		//printk("%08X\n", c.lastdata);
		
		
		//printk("%8i %8i\n", c.num_irq, c.num_drdy);
		//printk("    " MCP356X_PRINTF_HEADER "\n");
		//printk("avg " MCP356X_PRINTF_PLUS "\n", MCP356X_ARGS(c.avg));
		//printk("min " MCP356X_PRINTF_PLUS "\n", MCP356X_ARGS(c.val_min));
		//printk("max " MCP356X_PRINTF_PLUS "\n", MCP356X_ARGS(c.val_max));
		//printk("n   " MCP356X_PRINTF_PLUS "\n", MCP356X_ARGS(c.n));
		
		//egadc_log_REG_IRQ(&c.bus, MCP356X_REG_IRQ);

		
		
		//mybt_progress();
		//bt_bas_set_battery_level(i++);

		//k_sem_give(&c.acq_sem);
		k_sleep(K_MSEC(1000));
	}
}
```

## src/MCP356X.c
```c
#include "MCP356X.h"


char const * MCP356X_REG_tostring(int a)
{
	switch(a)
	{
	case MCP356X_REG_ADC_DATA    : return "MCP356X_REG_ADC_DATA    ";
	case MCP356X_REG_CFG_0       : return "MCP356X_REG_CFG_0       ";
	case MCP356X_REG_CFG_1       : return "MCP356X_REG_CFG_1       ";
	case MCP356X_REG_CFG_2       : return "MCP356X_REG_CFG_2       ";
	case MCP356X_REG_CFG_3       : return "MCP356X_REG_CFG_3       ";
	case MCP356X_REG_IRQ         : return "MCP356X_REG_IRQ         ";
	case MCP356X_REG_MUX         : return "MCP356X_REG_MUX         ";
	case MCP356X_REG_SCAN        : return "MCP356X_REG_SCAN        ";
	case MCP356X_REG_TIMER       : return "MCP356X_REG_TIMER       ";
	case MCP356X_REG_OFFSET_CAL  : return "MCP356X_REG_OFFSET_CAL  ";
	case MCP356X_REG_GAIN_CAL    : return "MCP356X_REG_GAIN_CAL    ";
	case MCP356X_RSV_REG_W_A     : return "MCP356X_RSV_REG_W_A     ";
	case MCP356X_REG_LOCK        : return "MCP356X_REG_LOCK        ";
	case MCP356X_RSV_REG         : return "MCP356X_RSV_REG         ";
	case MCP356X_REG_CRC_CFG     : return "MCP356X_REG_CRC_CFG     ";
	default:return "";
	}
}







/*
111 = Gain is x64 (x16 analog, x4 digital)
110 = Gain is x32 (x16 analog, x2 digital)
101 = Gain is x16
100 = Gain is x8
011 = Gain is x4
010 = Gain is x2
001 = Gain is x1 (default)
000 = Gain is x1/3
*/

int32_t MCP356X_raw_to_millivolt(int32_t raw, int32_t vref_mv, int32_t gain_reg)
{
	int32_t c = (MCP356X_CALC_COEF / vref_mv);
	switch(gain_reg)
	{
	case MCP356X_CFG_2_GAIN_X_64  : c *= 64; break;
	case MCP356X_CFG_2_GAIN_X_32  : c *= 32; break;
	case MCP356X_CFG_2_GAIN_X_16  : c *= 16; break;
	case MCP356X_CFG_2_GAIN_X_8   : c *= 8; break;
	case MCP356X_CFG_2_GAIN_X_4   : c *= 4; break;
	case MCP356X_CFG_2_GAIN_X_2   : c *= 2; break;
	case MCP356X_CFG_2_GAIN_X_1   : c *= 1; break;
	case MCP356X_CFG_2_GAIN_X_033 : c /= 3; break;
	}
	int32_t mv;
	mv = raw / c;
	return mv;
}

/*
In DATA_FORMAT[1:0] = 11, the output code is similar
to the one in DATA_FORMAT[1:0] = 10. The only differ-
ence resides in the four MSbs of the first byte, which
are no longer repeats of the Sign bit (SGN). They are
the Channel ID data (CH_ID[3:0]) that are defined in
Table 5-14. This CH_ID[3:0] word can be used to verify
that the right channel has been converted to SCAN
mode and can serve easy data retrieval and logging
(see Section 5.14 “SCAN Mode” for more details
about the SCAN mode). In MUX mode, this 4-bit word
is defaulted to ‘0000’ and does not vary with the
MUX[7:0] selection. This format is useful for 32-bit
MCU applications.
*/
void MCP356X_ADC_DATA_decode_11(uint8_t rx[5], int32_t * out_value, uint8_t * out_channel)
{
	(*out_channel) = (rx[1] >> 4) & 0x0F;
	uint8_t sign = rx[1] & 0x01;
	(*out_value) = (rx[2] << 16) | (rx[3] << 8) | (rx[4] << 0);
	if (sign != 0)
	{
		(*out_value) -= 16777215;
	}
}




uint32_t MCP356X_get_len(uint8_t reg)
{
	switch(reg)
	{
	case MCP356X_REG_ADC_DATA:
		return 4; // 32 bit
	case MCP356X_REG_CFG_0:
	case MCP356X_REG_CFG_1:
	case MCP356X_REG_CFG_2:
	case MCP356X_REG_CFG_3:
	case MCP356X_REG_IRQ:
	case MCP356X_REG_MUX:
		return 1; // 8 bit
	case MCP356X_REG_SCAN:
	case MCP356X_REG_TIMER:
	case MCP356X_REG_OFFSET_CAL:
	case MCP356X_REG_GAIN_CAL:
	case MCP356X_RSV_REG_W_A:
		return 3; // 24 bit
	case MCP356X_REG_C:
	case MCP356X_REG_LOCK:
		return 1; // 8 bit
	case MCP356X_RSV_REG:
	case MCP356X_REG_CRC_CFG:
		return 2; // 16 bit
	default:
		return 0;
		break;
	}
}


uint32_t MCP356X_get_value(uint8_t rx[5], uint8_t len)
{
	switch (len)
	{
	case 1: return (rx[1] << 0);
	case 2: return (rx[1] << 8) | (rx[2] << 0);
	case 3: return (rx[1] << 16) | (rx[2] << 8) | (rx[3] << 0);
	case 4: return (rx[1] << 24) | (rx[2] << 16) | (rx[3] << 8) | (rx[4] << 0);
	default: return 0;
	}
}


void MCP356X_set_value(uint8_t tx[5], uint8_t len, uint32_t value)
{
	switch (len)
	{
	case 1:
		tx[1] = ( value >> 0 ) & 0xFF;
		break;
	case 2:
		tx[1] = ( value >> 8 ) & 0xFF;
		tx[2] = ( value >> 0 ) & 0xFF;
		break;
	case 3:
		tx[1] = ( value >> 16 ) & 0xFF;
		tx[2] = ( value >> 8 ) & 0xFF;
		tx[3] = ( value >> 0 ) & 0xFF;
		break;
	case 4:
		tx[1] = ( value >> 24 ) & 0xFF;
		tx[2] = ( value >> 16 ) & 0xFF;
		tx[3] = ( value >> 8 ) & 0xFF;
		tx[4] = ( value >> 0 ) & 0xFF;
		break;
	default:
		tx[1] = 0;
		tx[2] = 0;
		tx[3] = 0;
		tx[4] = 0;
		break;
	}
}
```

## src/MCP356X.h
```c
#pragma once
#include <stdint.h>

// https://github.com/MikroElektronika/mikrosdk_click_v2
// https://github.com/MikroElektronika/mikrosdk_click_v2/tree/master/clicks/adc9
// https://github.com/jspark311/MCP356x-Breakout/blob/6cc57254ad991eba59b2607941b86dc148f06eaf/Arduino/src/MCP356x.cpp






/*****************************************************************
6.2.1 COMMAND BYTE STRUCTURE
The COMMAND byte fully defines the command that
will be executed by the part. This byte is divided into
three parts: the device address bits (CMD[7:6]), the
command address bits (CMD[5:2]) and the
command-type bits (CMD[1:0]).
*****************************************************************/
#define MCP356X_COMMAND_BYTE(addr, cmd, type) (((addr)<<6) | ((cmd)<<2) | ((type)<<0))

/*****************************************************************
6.2.2 DEVICE ADDRESS BITS (CMD[7:6])
The SPI interface of the MCP3561/2/4 devices is
addressable, which means that multiple devices can
communicate on the same SPI bus with only one Chip
Select line for all devices. Each device communication
starts by a CS falling edge, followed by the clocking of
the device address (CMD[7:6]). Each device contains
an internal device address which the device can
respond to.
This address is coded on two bits, so four possible
addresses are available. Device address is hard-coded
within the device and should be determined when
ordering the device. The device address is part of the
device markings to avoid potential confusion (see
Sections 9.1 “Package Marking Information(1)”).
When the CMD[7:6] bits match the device address, the
communication will proceed and the part will execute
the commands defined in the control byte and its
subsequent data bytes.
When the CMD[7:6] bits do not correspond to the
address hard-coded in the device, the command is
ignored. In this case, the SDO output will become
high-impedance, which prevents bus contention errors
when multiple devices are connected on the same SPI
bus (see Figure 6-2). The user has to exit from this
communication through a CS rising edge to be able to
launch another command.
*****************************************************************/
#define MCP356X_DEVICE_ADR                   0x01 // CMD[7:6]

/*****************************************************************
6.2.4 COMMAND-TYPE BITS (CMD[1:0])
The last two bits of the COMMAND register byte define
the command type. These bits are an extension of the
typical read/write bits present in most SPI communica-
tion protocols. The two bits define four possible
command types: Incremental Write, Incremental Read,
Static Read and Fast command. Changing the com-
mand type within the same communication (while CS is
logic low) is not possible. The communication has to be
stopped (CS rising edge) and restarted (CS falling
edge) to change its command type.
*****************************************************************/
#define MCP356X_CMD_DONT_CARE                0x00
#define MCP356X_CMD_STAT_READ                0x01
#define MCP356X_CMD_INC_WRITE                0x02
#define MCP356X_CMD_INC_READ                 0x03

/*****************************************************************
8.0 INTERNAL REGISTERS
The MCP3561/2/4 devices have a total of 16 internal
registers made of volatile memory.
*****************************************************************/

/*
8.1 ADCDATA Register
The data can be
formatted in 24/32-bit modes depending on the DATA_FORMAT
*/
#define MCP356X_REG_ADC_DATA                 0x00 // 4/24/32 R
#define MCP356X_REG_CFG_0                    0x01 // 8       RW
#define MCP356X_REG_CFG_1                    0x02 // 8       RW
#define MCP356X_REG_CFG_2                    0x03 // 8       RW
#define MCP356X_REG_CFG_3                    0x04 // 8       RW
#define MCP356X_REG_IRQ                      0x05 // 8       RW
#define MCP356X_REG_MUX                      0x06 // 8       RW
#define MCP356X_REG_SCAN                     0x07 // 24      RW
#define MCP356X_REG_TIMER                    0x08 // 24      RW
#define MCP356X_REG_OFFSET_CAL               0x09 // 24      RW
#define MCP356X_REG_GAIN_CAL                 0x0A // 24      RW
#define MCP356X_RSV_REG_W_A                  0x0B // 24      RW
#define MCP356X_REG_C                        0x0C // 8       RW
#define MCP356X_REG_LOCK                     0x0D // 8       RW
#define MCP356X_RSV_REG                      0x0E // 16      RW
#define MCP356X_REG_CRC_CFG                  0x0F // 16      R






/*****************************************************************
8.2 CONFIG0 Register
ADC Operating mode, Master Clock mode and Input Bias Current
Source mode
******************************************************************/
// Full Shutdown Mode Enable
#define MCP356X_CFG_0_VREF_SEL_0             0x00
#define MCP356X_CFG_0_VREF_SEL_1             0x40
#define MCP356X_CFG_0_VREF_SEL_2             0x80
#define MCP356X_CFG_0_VREF_SEL_3             0xC0
// Clock Selection
#define MCP356X_CFG_0_CLK_SEL_0              0x00
#define MCP356X_CFG_0_CLK_SEL_1              0x10
#define MCP356X_CFG_0_CLK_SEL_2              0x20
#define MCP356X_CFG_0_CLK_SEL_3              0x30
// Current Source/Sink Selection Bits for Sensor Bias (source on VIN+/sink on VIN-)
#define MCP356X_CFG_0_CS_SEL_0               0x00
#define MCP356X_CFG_0_CS_SEL_1               0x04
#define MCP356X_CFG_0_CS_SEL_2               0x08
#define MCP356X_CFG_0_CS_SEL_3               0x0C
// ADC Operating Mode Selection
#define MCP356X_CFG_0_MODE_SHD_DEF           0x00
#define MCP356X_CFG_0_MODE_SHD               0x01
#define MCP356X_CFG_0_MODE_STANDBY           0x02
#define MCP356X_CFG_0_MODE_CONV              0x03




/******************************************************************
8.3 CONFIG1 Register
Prescale and OSR settings
******************************************************************/
// Prescaler Value Selection for AMCLK
#define MCP356X_CFG_1_PRE_1                  0x00
#define MCP356X_CFG_1_PRE_2                  0x40
#define MCP356X_CFG_1_PRE_4                  0x80
#define MCP356X_CFG_1_PRE_8                  0xC0
// Oversampling Ratio for Delta-Sigma A/D Conversion
#define MCP356X_CFG_1_OSR_98304              0x3C
#define MCP356X_CFG_1_OSR_81920              0x38
#define MCP356X_CFG_1_OSR_49152              0x34
#define MCP356X_CFG_1_OSR_40960              0x30
#define MCP356X_CFG_1_OSR_24576              0x2C
#define MCP356X_CFG_1_OSR_20480              0x28
#define MCP356X_CFG_1_OSR_16384              0x24
#define MCP356X_CFG_1_OSR_8192               0x20
#define MCP356X_CFG_1_OSR_4096               0x1C
#define MCP356X_CFG_1_OSR_2048               0x18
#define MCP356X_CFG_1_OSR_1024               0x14
#define MCP356X_CFG_1_OSR_512                0x10
#define MCP356X_CFG_1_OSR_256                0x0C
#define MCP356X_CFG_1_OSR_128                0x08
#define MCP356X_CFG_1_OSR_64                 0x04
#define MCP356X_CFG_1_OSR_32                 0x00
// RESERVED[1:0]: Should always be set to ‘00’
#define MCP356X_CFG_1_DITHER_MAX             0x03
#define MCP356X_CFG_1_DITHER_MED             0x02
#define MCP356X_CFG_1_DITHER_MIN             0x01
#define MCP356X_CFG_1_DITHER_DEF             0x00





/******************************************************************
8.4 CONFIG2 Register
ADC boost and gain settings, auto-zeroing settings for analog
multiplexer, voltage reference and ADC
******************************************************************/
// ADC Bias Current Selection
#define MCP356X_CFG_2_BOOST_X_2              0xC0
#define MCP356X_CFG_2_BOOST_X_1              0x80
#define MCP356X_CFG_2_BOOST_X_066            0x40
#define MCP356X_CFG_2_BOOST_X_05             0x00
/*
5.3.1
ANALOG GAIN
The gain settings from 0.33x to 16x are done in the
analog domain. This analog gain is placed on each ADC
differential input. Each doubling of the gain improves the
thermal noise due to sampling by approximately 3 dB,
which means the lowest noise configuration is obtained
when using the highest analog gain. The SNR, however,
is degraded, since doubling the gain factor reduces the
maximum allowable input signal amplitude by
approximately 6 dB.
If the gain is set to 0.33x, the differential input range
theoretically becomes ±3 * VREF. However, the device
does not support input voltages outside of the power
supply voltage range. If large reference voltages are
used with this gain, the input voltage range will be
clipped between AGND and AVDD, and therefore, the
output code span will be limited. This gain is useful
when the reference voltage is small and when the
input signal voltage is large.
The analog gain stage can be used to amplify very low
signals, but the differential input range of the
Delta-Sigma modulator must not be exceeded.
*/
#define MCP356X_CFG_2_GAIN_X_64              0x38
#define MCP356X_CFG_2_GAIN_X_32              0x30
#define MCP356X_CFG_2_GAIN_X_16              0x28
#define MCP356X_CFG_2_GAIN_X_8               0x20
#define MCP356X_CFG_2_GAIN_X_4               0x18
#define MCP356X_CFG_2_GAIN_X_2               0x10
#define MCP356X_CFG_2_GAIN_X_1               0x08
#define MCP356X_CFG_2_GAIN_X_033             0x00
// Auto-Zeroing MUX Setting
#define MCP356X_CFG_2_AZ_MUX_EN              0x04
#define MCP356X_CFG_2_AZ_MUX_DIS             0x00
#define MCP356X_CFG_2_AZ_VREF_EN             0x02
#define MCP356X_CFG_2_AZ_VREF_DIS            0x00
// RESERVED[1:0]: Should always be equal to ‘11’
#define MCP356X_CFG_2_AZ_FREQ_HIGH           0x01
#define MCP356X_CFG_2_AZ_FREQ_LOW            0x00




/******************************************************************
8.5 CONFIG3 Register
Conversion mode, data and CRC format settings; enable for CRC on
communications, enable for digital offset and gain error calibrations
*******************************************************************/
// Conversion Mode Selection
#define MCP356X_CFG_3_CONV_MODE_CONT         0xC0
#define MCP356X_CFG_3_CONV_MODE_STANDBY      0x80
#define MCP356X_CFG_3_CONV_MODE_SHD          0x40
#define MCP356X_CFG_3_CONV_MODE_SHD0         0x00

// ADC Output Data Format Selection

// 32-bit (25-bit right justified data + Channel ID): CHID[3:0] + SGN extension (4 bits) + 24-bit ADC data. 
// It allows overrange with the SGN extension.
#define MCP356X_CFG_3_DATA_FORMAT_CH_ADC     0x30
// 32-bit (25-bit right justified data): SGN extension (8-bit) + 24-bit ADC data. It allows overrange with the SGN extension.
#define MCP356X_CFG_3_DATA_FORMAT_SIGN_ADC   0x20
// 32-bit (24-bit left justified data): 24-bit ADC data + 0x00 (8-bit). It does not allow overrange (ADC code locked to 0xFFFFFF or 0x800000).
#define MCP356X_CFG_3_DATA_FORMAT_LEFT_JUST  0x10
//24-bit (default ADC coding): 24-bit ADC data. It does not allow overrange (ADC code locked to 0xFFFFFF or 0x800000).
#define MCP356X_CFG_3_DATA_FORMAT_DEF        0x00

// CRC Checksum Format Selection on Read Communications
#define MCP356X_CFG_3_CRC_FORMAT_32          0x08
#define MCP356X_CFG_3_CRC_FORMAT_16          0x00
// CRC Checksum Selection on Read Communications (it does not affect CRCCFG calculations)
#define MCP356X_CFG_3_CRC_COM_EN             0x04
#define MCP356X_CFG_3_CRC_COM_DIS            0x00
// Enable Digital Offset Calibration
#define MCP356X_CFG_3_CRC_OFF_CAL_EN         0x02
#define MCP356X_CFG_3_CRC_OFF_CAL_DIS        0x00
// Enable Digital Gain Calibration
#define MCP356X_CFG_3_CRC_GAIN_CAL_EN        0x01
#define MCP356X_CFG_3_CRC_GAIN_CAL_DIS       0x00



/*******************************************************************
8.6 IRQ Register
IRQ Status bits and IRQ mode settings; enable for Fast commands and
for conversion start pulse
*******************************************************************/
#define MCP356X_IRQ_MODE_MDAT                0x08
#define MCP356X_IRQ_MODE_IRQ                 0x00
#define MCP356X_IRQ_MODE_LOGIC_HIGH          0x04
#define MCP356X_IRQ_MODE_HIGH_Z              0x00
#define MCP356X_IRQ_FASTCMD_EN               0x02
#define MCP356X_IRQ_FASTCMD_DIS              0x00
#define MCP356X_IRQ_STP_EN                   0x01
#define MCP356X_IRQ_STP_DIS                  0x00

#define MCP356X_IRQ_MASK_EN_STP        0x01
#define MCP356X_IRQ_MASK_EN_FASTCMD    0x02
#define MCP356X_IRQ_MASK_MODE0         0x04
#define MCP356X_IRQ_MASK_MODE1         0x08
#define MCP356X_IRQ_MASK_POR_STATUS    0x10
#define MCP356X_IRQ_MASK_CRCCFG_STATUS 0x20
#define MCP356X_IRQ_MASK_DR_STATUS     0x40
#define MCP356X_IRQ_MASK_UNIMPLEMENTED 0x80



/*******************************************************************
8.7 MULTIPLEXER (MUX) REGISTER
Analog multiplexer input selection (MUX mode only)
*******************************************************************/
// Bit 7-4 MUX_VIN+ Input Selection
#define MCP356X_MUX_VIN_POS_NO_IN            0xF0 // 1111 0000 Internal VCM
#define MCP356X_MUX_VIN_POS_VCM              0xE0 // 1110 0000 Internal Temperature Sensor Diode M (Temp Diode M)(1)
#define MCP356X_MUX_VIN_POS_TEMP             0xD0 // 1101 0000 Internal Temperature Sensor Diode P (Temp Diode P)(1)
#define MCP356X_MUX_VIN_POS_VREF_EXT_MINUS   0xC0 // 1100 0000
#define MCP356X_MUX_VIN_POS_VREF_EXT_PLUS    0xB0 // 1011 0000
#define MCP356X_MUX_VIN_POS_VREF_INT         0xA0 // 1010 0000 Reserved (do not use)
#define MCP356X_MUX_VIN_POS_AVDD             0x90 // 1001 0000
#define MCP356X_MUX_VIN_POS_AGND             0x80 // 1000 0000
#define MCP356X_MUX_VIN_POS_CH7              0x70 // 0111 0000
#define MCP356X_MUX_VIN_POS_CH6              0x60 // 0110 0000
#define MCP356X_MUX_VIN_POS_CH5              0x50 // 0101 0000
#define MCP356X_MUX_VIN_POS_CH4              0x40 // 0100 0000
#define MCP356X_MUX_VIN_POS_CH3              0x30 // 0011 0000
#define MCP356X_MUX_VIN_POS_CH2              0x20 // 0010 0000
#define MCP356X_MUX_VIN_POS_CH1              0x10 // 0001 0000
#define MCP356X_MUX_VIN_POS_CH0              0x00 // 0000 0000
// Bit 3-0 MUX_VIN- Input Selection
#define MCP356X_MUX_VIN_NEG_NO_IN            0x0F // 0000 1111
#define MCP356X_MUX_VIN_NEG_VCM              0x0E // 0000 1110 Internal Temperature Sensor Diode M (Temp Diode M)(1)
#define MCP356X_MUX_VIN_NEG_TEMP             0x0D // 0000 1101 Internal Temperature Sensor Diode P (Temp Diode P)(1)
#define MCP356X_MUX_VIN_NEG_VREF_EXT_MINUS   0x0C // 0000 1100
#define MCP356X_MUX_VIN_NEG_VREF_EXT_PLUS    0x0B // 0000 1011
#define MCP356X_MUX_VIN_NEG_VREF_INT         0x0A // 0000 1010 Reserved (do not use)
#define MCP356X_MUX_VIN_NEG_AVDD             0x09 // 0000 1001
#define MCP356X_MUX_VIN_NEG_AGND             0x08 // 0000 1000
#define MCP356X_MUX_VIN_NEG_CH7              0x07 // 0000 0111
#define MCP356X_MUX_VIN_NEG_CH6              0x06 // 0000 0110
#define MCP356X_MUX_VIN_NEG_CH5              0x05 // 0000 0101
#define MCP356X_MUX_VIN_NEG_CH4              0x04 // 0000 0100
#define MCP356X_MUX_VIN_NEG_CH3              0x03 // 0000 0011
#define MCP356X_MUX_VIN_NEG_CH2              0x02 // 0000 0010
#define MCP356X_MUX_VIN_NEG_CH1              0x01 // 0000 0001
#define MCP356X_MUX_VIN_NEG_CH0              0x00 // 0000 0000




/* 8.8 SCAN Register
Bit 23-21 DLY[2:0]: Delay Time (TDLY_SCAN) Between Each Conversion During a Scan Cycle

When in SCAN mode, the MUX register (address: 0x6)
becomes a Don’t Care register.

When SCAN[15:0] = 0x0000, SCAN mode is dis-
abled and the part returns to MUX mode, where the
input channel selection is defined by the MUX[7:0] bits.
*/
#define MCP356X_SCAN_DLY_DM_CLK_X_512        0x00E00000
#define MCP356X_SCAN_DLY_DM_CLK_X_256        0x00C00000
#define MCP356X_SCAN_DLY_DM_CLK_X_128        0x00A00000
#define MCP356X_SCAN_DLY_DM_CLK_X_64         0x00800000
#define MCP356X_SCAN_DLY_DM_CLK_X_32         0x00600000
#define MCP356X_SCAN_DLY_DM_CLK_X_16         0x00400000
#define MCP356X_SCAN_DLY_DM_CLK_X_8          0x00200000
#define MCP356X_SCAN_DLY_NO_DELAY            0x00000000
//Bit 19-16 Unimplemented: Read as ‘0’
#define MCP356X_SCAN_PSAV_VREF_OFF           0x00100000
#define MCP356X_SCAN_PSAV_VREF_ON            0x00000000
// Bit 15-0 Scan Channel Selection (see Table 5-14 for a complete description)
#define MCP356X_SCAN_OFFSET                  0x00008000
#define MCP356X_SCAN_VREF                    0x00004000
#define MCP356X_SCAN_AVDD                    0x00002000
#define MCP356X_SCAN_TEMP                    0x00001000
#define MCP356X_SCAN_DIFF_D                  0x00000800
#define MCP356X_SCAN_DIFF_C                  0x00000400
#define MCP356X_SCAN_DIFF_B                  0x00000200
#define MCP356X_SCAN_DIFF_A                  0x00000100
#define MCP356X_SCAN_CH7                     0x00000080
#define MCP356X_SCAN_CH6                     0x00000040
#define MCP356X_SCAN_CH5                     0x00000020
#define MCP356X_SCAN_CH4                     0x00000010
#define MCP356X_SCAN_CH3                     0x00000008
#define MCP356X_SCAN_CH2                     0x00000004
#define MCP356X_SCAN_CH1                     0x00000002
#define MCP356X_SCAN_CH0                     0x00000001


/*
5.14.3.4 VCM Reading (V CM )
During the conversion that reads VCM , the device
monitors the internal Common-mode voltage of the
device in order to ensure proper operation.
The VCM voltage of the device should be located at
1.2V ± 2% to ensure proper accuracy. With this setting,
the internal multiplexer setting becomes 0xF8
(VCM – AGND). In order to properly measure VCM , the
reference voltage must be larger than 1.2V.
During the VCM reading, the gain of the ADC is set to 1x
regardless of the GAIN[2:0] settings. This temporary inter-
nal configuration does not change the register setting, it
impacts the gain of the device during this conversion.
The VCM reading is susceptible to the gain and offset
errors of the ADC, which should be calibrated to obtain
a precise internal Common-mode measurement.

Differential Channel D (CH6-CH7) 1011 0x67 None
10 Differential Channel C (CH4-CH5) 1010 0x45 None
9 Differential Channel B (CH2-CH3) 1001 0x23 None
8 Differential Channel A (CH0-CH1)
*/

#define MCP356X_CHANNEL_COUNT 16
#define MCP356X_CH_OFFSET   15
#define MCP356X_CH_VCM     14
#define MCP356X_CH_AVDD     13
#define MCP356X_CH_TEMP     12
#define MCP356X_CH_DIFF_D   11 // Differential Channel D (CH6-CH7)
#define MCP356X_CH_DIFF_C   10 // Differential Channel C (CH4-CH5)
#define MCP356X_CH_DIFF_B   9 // Differential Channel B (CH2-CH3)
#define MCP356X_CH_DIFF_A   8 // Differential Channel A (CH0-CH1)
#define MCP356X_CH_CH7      7
#define MCP356X_CH_CH6      6
#define MCP356X_CH_CH5      5
#define MCP356X_CH_CH4      4
#define MCP356X_CH_CH3      3
#define MCP356X_CH_CH2      2
#define MCP356X_CH_CH1      1
#define MCP356X_CH_CH0      0



// 8.9 TIMER Register
#define MCP356X_TIMER_DLY_DMCLK_X_16777215   0x00FFFFFF
#define MCP356X_TIMER_DLY_DMCLK_X_8388607    0x007FFFFF
#define MCP356X_TIMER_DLY_DMCLK_X_4194303    0x003FFFFF
#define MCP356X_TIMER_DLY_DMCLK_X_2097151    0x001FFFFF
#define MCP356X_TIMER_DLY_DMCLK_X_1048575    0x000FFFFF
#define MCP356X_TIMER_DLY_DMCLK_X_524287     0x0007FFFF
#define MCP356X_TIMER_DLY_DMCLK_X_262143     0x0003FFFF
#define MCP356X_TIMER_DLY_DMCLK_X_131071     0x0001FFFF
#define MCP356X_TIMER_DLY_DMCLK_X_65535      0x0000FFFF
#define MCP356X_TIMER_DLY_DMCLK_X_32767      0x00007FFF
#define MCP356X_TIMER_DLY_DMCLK_X_16383      0x00003FFF
#define MCP356X_TIMER_DLY_DMCLK_X_8191       0x00001FFF
#define MCP356X_TIMER_DLY_DMCLK_X_4095       0x00000FFF
#define MCP356X_TIMER_DLY_DMCLK_X_2047       0x000007FF
#define MCP356X_TIMER_DLY_DMCLK_X_1023       0x000003FF
#define MCP356X_TIMER_DLY_DMCLK_X_511        0x000001FF
#define MCP356X_TIMER_DLY_DMCLK_X_255        0x000000FF
#define MCP356X_TIMER_DLY_DMCLK_X_127        0x0000007F
#define MCP356X_TIMER_DLY_DMCLK_X_63         0x0000003F
#define MCP356X_TIMER_DLY_DMCLK_X_31         0x0000001F
#define MCP356X_TIMER_DLY_DMCLK_X_15         0x0000000F
#define MCP356X_TIMER_DLY_DMCLK_X_2          0x00000002
#define MCP356X_TIMER_DLY_DMCLK_X_1          0x00000001
#define MCP356X_TIMER_DLY_NO_DELAY           0x00000000

#define MCP356X_FAST_CMD_ADC_CONV_START      0x28
#define MCP356X_FAST_CMD_ADC_STANDBY_MODE    0x2C
#define MCP356X_FAST_CMD_ADC_SHUTDOWN_MODE   0x30
#define MCP356X_FAST_CMD_FULL_SHUTDOWN_MODE  0x34
#define MCP356X_FAST_CMD_DEV_FULL_RESET      0x38

#define MCP356X_CALC_COEF                    8388608


#define MCP356X_PRINTF_HEADER "OFFST VCM   AVDD  TEMP  DIFFD DIFFC DIFFB DIFFA CH7   CH6   CH5   CH4   CH3   CH2   CH1   CH0"
#define MCP356X_PRINTF_PLUS   "%+05i %+05i %+05i %+05i %+05i %+05i %+05i %+05i %+05i %+05i %+05i %+05i %+05i %+05i %+05i %+05i"
#define MCP356X_PRINTF "%05i %05i %05i %05i %05i %05i %05i %05i %05i %05i %05i %05i %05i %05i %05i %05i"
#define MCP356X_ARGS(x) \
(x)[MCP356X_CH_OFFSET],  \
(x)[MCP356X_CH_VCM],  \
(x)[MCP356X_CH_AVDD],  \
(x)[MCP356X_CH_TEMP],  \
(x)[MCP356X_CH_DIFF_D],  \
(x)[MCP356X_CH_DIFF_C],  \
(x)[MCP356X_CH_DIFF_B],  \
(x)[MCP356X_CH_DIFF_A],  \
(x)[MCP356X_CH_CH7],  \
(x)[MCP356X_CH_CH6],  \
(x)[MCP356X_CH_CH5],  \
(x)[MCP356X_CH_CH4],  \
(x)[MCP356X_CH_CH3],  \
(x)[MCP356X_CH_CH2],  \
(x)[MCP356X_CH_CH1],  \
(x)[MCP356X_CH_CH0]



char const * MCP356X_REG_tostring(int a);
int32_t MCP356X_raw_to_millivolt(int32_t raw, int32_t vref_mv, int32_t gain_reg);
void MCP356X_ADC_DATA_decode_11(uint8_t rx[5], int32_t * out_value, uint8_t * out_channel);
uint32_t MCP356X_get_len(uint8_t reg);
uint32_t MCP356X_get_value(uint8_t rx[5], uint8_t len);
void MCP356X_set_value(uint8_t tx[5], uint8_t len, uint32_t value);
```

## src/bt.c
```c
#include <stdbool.h>
#include <stddef.h>
#include <string.h>
#include <errno.h>

#include <zephyr/types.h>
#include <zephyr/sys/printk.h>
#include <zephyr/sys/byteorder.h>
#include <zephyr/kernel.h>

#include <zephyr/bluetooth/bluetooth.h>
#include <zephyr/bluetooth/hci.h>
#include <zephyr/bluetooth/conn.h>
#include <zephyr/bluetooth/uuid.h>
#include <zephyr/bluetooth/gatt.h>
#include <zephyr/bluetooth/services/bas.h>

#include <zephyr/logging/log.h>
LOG_MODULE_REGISTER(adc_svc, CONFIG_APP_LOG_LEVEL);


/*
GATT Characteristic and Object Type | 0x2AE1 | Average Voltage
*/
#define BT_UUID_VOLTAGE_VAL 0x2B18
#define BT_UUID_VOLTAGE BT_UUID_DECLARE_16(BT_UUID_VOLTAGE_VAL)

static ssize_t read_u16(struct bt_conn *conn, const struct bt_gatt_attr *attr,void *buf, uint16_t len, uint16_t offset)
{
	const uint16_t *u16 = attr->user_data;
	uint16_t value = sys_cpu_to_le16(*u16);
	return bt_gatt_attr_read(conn, attr, buf, len, offset, &value,sizeof(value));
}

static struct bt_uuid_128 service1_uuid = BT_UUID_INIT_128(BT_UUID_128_ENCODE(0x0000fe40, 0xcc7a, 0x482a, 0x984a, 0x7f2ed5b3e58f));



struct gatt_values
{
	uint16_t voltage[2];
	const struct bt_gatt_attr *attr[10];
};

static struct gatt_values values;


static void ccc_cfg_changed(const struct bt_gatt_attr *attr, uint16_t value);

BT_GATT_SERVICE_DEFINE(service1,
	BT_GATT_PRIMARY_SERVICE(&service1_uuid),
	BT_GATT_CHARACTERISTIC(BT_UUID_TEMPERATURE, BT_GATT_CHRC_READ | BT_GATT_CHRC_NOTIFY, BT_GATT_PERM_READ, read_u16, NULL, &values.voltage[0]),
	BT_GATT_CCC(ccc_cfg_changed, BT_GATT_PERM_READ | BT_GATT_PERM_WRITE),
	BT_GATT_CHARACTERISTIC(BT_UUID_TEMPERATURE, BT_GATT_CHRC_READ | BT_GATT_CHRC_NOTIFY, BT_GATT_PERM_READ, read_u16, NULL, &values.voltage[1]),
	BT_GATT_CCC(ccc_cfg_changed, BT_GATT_PERM_READ | BT_GATT_PERM_WRITE),
);

static void ccc_cfg_changed(const struct bt_gatt_attr *attr, uint16_t value)
{
	uint16_t * v = service1.attrs[0].user_data;
	LOG_INF("ccc_cfg_changed %i", (int)(*v));
	if (attr->user_data == &values.voltage[0])
	{
		LOG_INF("ccc_cfg_changed 0");
	}
	else if (attr->user_data == &values.voltage[0])
	{
		LOG_INF("ccc_cfg_changed 1");
	}
}


static void connected(struct bt_conn *conn, uint8_t err)
{
	if (err) {
		printk("Connection failed (err 0x%02x)\n", err);
	} else {
		printk("Connected\n");
	}
	
}

static void disconnected(struct bt_conn *conn, uint8_t reason)
{
	printk("Disconnected (reason 0x%02x)\n", reason);
}

BT_CONN_CB_DEFINE(conn_callbacks) = {
	.connected = connected,
	.disconnected = disconnected,
};



static const struct bt_data ad[] = {
	BT_DATA_BYTES(BT_DATA_FLAGS, (BT_LE_AD_GENERAL | BT_LE_AD_NO_BREDR))
};



static void bt_ready(int err)
{
	if (err) {
		LOG_ERR("Bluetooth init failed (err %d)", err);
		return;
	}
	LOG_INF("Bluetooth initialized. Connecting and disconnecting and connecting fails.");
	/* Start advertising */
	err = bt_le_adv_start(BT_LE_ADV_CONN_NAME, ad, ARRAY_SIZE(ad), NULL, 0);
	if (err) {
		LOG_ERR("Advertising failed to start (err %d)", err);
		return;
	}

	LOG_INF("Configuration mode: waiting connections...");
}


static void bas_notify(void)
{
	uint8_t battery_level = bt_bas_get_battery_level();
	battery_level--;
	if (!battery_level) {
		battery_level = 100U;
	}
	//bt_bas_set_battery_level(battery_level);
}



void mybt_init(void)
{
	int err;
	err = bt_enable(bt_ready);
	if (err) {
		printk("Bluetooth init failed (err %d)\n", err);
		return;
	}
}



void mybt_progress(void)
{
    bas_notify();
	values.voltage[0] += 1;
	values.voltage[1] += 1;

	
	//bt_gatt_notify(NULL, attr, &value, sizeof(value));
}
```

## src/egadc.c
```c
#include "egadc.h"

#include <zephyr/drivers/spi.h>
#include <zephyr/sys/util.h>
#include <zephyr/logging/log.h>


#include "MCP356X.h"


LOG_MODULE_REGISTER(adc_mcp356x, LOG_LEVEL_DBG);


void MCP356X_log_REG_IRQ(uint32_t value)
{
	LOG_INF("EN_STP:        %i", !!(value & MCP356X_IRQ_MASK_EN_STP));
	LOG_INF("EN_FASTCMD:    %i", !!(value & MCP356X_IRQ_MASK_EN_FASTCMD));
	LOG_INF("MODE0:         %i", !!(value & MCP356X_IRQ_MASK_MODE0));
	LOG_INF("MODE1:         %i", !!(value & MCP356X_IRQ_MASK_MODE1));
	LOG_INF("POR_STATUS:    %i", !!(value & MCP356X_IRQ_MASK_POR_STATUS));
	LOG_INF("CRCCFG_STATUS: %i", !!(value & MCP356X_IRQ_MASK_CRCCFG_STATUS));
	LOG_INF("DR_STATUS:     %i", !!(value & MCP356X_IRQ_MASK_DR_STATUS));
	LOG_INF("UNIMPLEMENTED: %i", !!(value & MCP356X_IRQ_MASK_UNIMPLEMENTED));
}

int transceive(const struct spi_dt_spec *bus, uint8_t *tx, uint8_t *rx, uint8_t reg, uint8_t len, uint8_t cmd)
{
	struct spi_buf buf_tx[] = {{.buf = tx,.len = len+1}};
	struct spi_buf buf_rx[] = {{.buf = rx,.len = len+1}};
	struct spi_buf_set tx_buf = {.buffers = buf_tx, .count = 1};
	struct spi_buf_set rx_buf = {.buffers = buf_rx, .count = 1};
	tx[0] = MCP356X_COMMAND_BYTE(MCP356X_DEVICE_ADR, reg, cmd);
	int rv = spi_transceive_dt(bus, &tx_buf, &rx_buf);
	return rv;
}


int get(const struct spi_dt_spec *bus, uint8_t reg, uint32_t * value)
{
	uint8_t len = MCP356X_get_len(reg);
	uint8_t tx[5] = {0};
	uint8_t rx[5] = {0};
	int rv = transceive(bus, tx, rx, reg, len, MCP356X_CMD_INC_READ);
	*value = MCP356X_get_value(rx, len);
	//printk("MCP356X_get_value: %2i : %02X : %02X %02X %02X %02X : %5i\n", len, rx[0], rx[1], rx[2], rx[3], rx[4], v);
	return rv;
}

/*
In MUX mode, channel is defaulted to 0.
*/
int get_data_11(const struct spi_dt_spec *bus, int32_t * out_value, uint8_t * out_channel)
{
	uint8_t reg = MCP356X_REG_ADC_DATA;
	uint8_t len = 4;
	uint8_t tx[5] = {0};
	uint8_t rx[5] = {0};
	int rv = transceive(bus, tx, rx, reg, len, MCP356X_CMD_INC_READ);
	MCP356X_ADC_DATA_decode_11(rx, out_value, out_channel);
	return rv;
}


int egadc_log_REG_IRQ(const struct spi_dt_spec *bus, uint8_t reg)
{
	uint32_t value;
	int rv = get(bus, reg, &value);
	if(reg == MCP356X_REG_IRQ)
	{
		MCP356X_log_REG_IRQ(value);
	}
	return rv;
}


#define MCP356X_LOG_SET_VALUE
static int set(const struct spi_dt_spec *bus, uint8_t reg, uint32_t value)
{
	uint8_t len = MCP356X_get_len(reg);
	uint8_t tx[5] = {0};
	uint8_t rx[5] = {0};
	MCP356X_set_value(tx, len, value);
	int rv = transceive(bus, tx, rx, reg, len, MCP356X_CMD_INC_WRITE);
#ifdef MCP356X_LOG_SET_VALUE
	uint32_t value2;
	rv = get(bus, reg, &value2);
	LOG_INF("Register set: %s: %08x %08x", MCP356X_REG_tostring(reg), value, value2);
	if(reg == MCP356X_REG_IRQ)
	{
		MCP356X_log_REG_IRQ(value2);
	}
#endif
return rv;
}






void egadc_setup_adc(struct mcp356x_config * config)
{
	LOG_INF("Setting registers in MCP356X");
	set(&config->bus, MCP356X_REG_LOCK, 0xA5); //Unlock
	set(&config->bus, MCP356X_REG_CFG_0,
	MCP356X_CFG_0_VREF_SEL_0 |
	MCP356X_CFG_0_CLK_SEL_2 |
	MCP356X_CFG_0_CS_SEL_0 |
	MCP356X_CFG_0_MODE_CONV
	);
	set(&config->bus, MCP356X_REG_CFG_1,
	MCP356X_CFG_1_PRE_1 |
	//MCP356X_CFG_1_OSR_32 |
	//MCP356X_CFG_1_OSR_256 |
	MCP356X_CFG_1_OSR_98304|
	MCP356X_CFG_1_DITHER_DEF
	);
	set(&config->bus, MCP356X_REG_CFG_2,
	MCP356X_CFG_2_BOOST_X_1 |
	//MCP356X_CFG_2_GAIN_X_1 |
	config->gain_reg |
	MCP356X_CFG_2_AZ_MUX_DIS |
	//MCP356X_CFG_2_AZ_VREF_EN |
	//MCP356X_CFG_2_AZ_FREQ_HIGH |
	0
	);
	set(&config->bus, MCP356X_REG_CFG_3,
	MCP356X_CFG_3_CONV_MODE_CONT |
	//MCP356X_CFG_3_DATA_FORMAT_DEF |
	MCP356X_CFG_3_DATA_FORMAT_CH_ADC |
	MCP356X_CFG_3_CRC_FORMAT_16 |
	MCP356X_CFG_3_CRC_COM_DIS |
	MCP356X_CFG_3_CRC_OFF_CAL_EN |
	MCP356X_CFG_3_CRC_GAIN_CAL_EN
	);
	
	/*
	set(&config->bus, MCP356X_REG_MUX,
	//MCP356X_MUX_VIN_POS_CH0 | //10Mohm + 1µA offset
	//MCP356X_MUX_VIN_POS_CH1 | //10Mohm
	//MCP356X_MUX_VIN_POS_CH5 | //100Mohm + 1µA offset
	MCP356X_MUX_VIN_POS_CH4 | //100Mohm
	//MCP356X_MUX_VIN_POS_CH3 | //1Gohm
	//MCP356X_MUX_VIN_POS_CH1 | 
	//MCP356X_MUX_VIN_POS_CH2 | 
	//MCP356X_MUX_VIN_POS_CH3 | 
	//MCP356X_MUX_VIN_POS_TEMP |
	//MCP356X_MUX_VIN_POS_AVDD | 
	//MCP356X_MUX_VIN_POS_VREF_EXT_PLUS|
	//MCP356X_MUX_VIN_NEG_CH1 |
	//MCP356X_MUX_VIN_POS_CH0 | 
	//MCP356X_MUX_VIN_POS_CH5 | 
	MCP356X_MUX_VIN_NEG_AGND |
	0);
	*/
	
	//set(&config->bus, MCP356X_REG_SCAN, 0);
	
	set(&config->bus, MCP356X_REG_SCAN, 
	//MCP356X_SCAN_CH0|
	//MCP356X_SCAN_CH1|
	//MCP356X_SCAN_CH2|
	//MCP356X_SCAN_CH3|
	//MCP356X_SCAN_CH4|
	//MCP356X_SCAN_CH5|
	//MCP356X_SCAN_CH6|
	//MCP356X_SCAN_CH7|
	//MCP356X_SCAN_VREF|
	//MCP356X_SCAN_TEMP|
	//MCP356X_SCAN_AVDD|
	//MCP356X_SCAN_OFFSET|
	0);
	
	//set24_verbose(bus, MCP356X_REG_SCAN, MCP356X_SCAN_CH0);
	//set24_verbose(bus, MCP356X_REG_SCAN, MCP356X_SCAN_CH3);
	
	set(&config->bus, MCP356X_REG_IRQ, MCP356X_IRQ_MODE_LOGIC_HIGH);
	set(&config->bus, MCP356X_REG_OFFSET_CAL, 0);
	set(&config->bus, MCP356X_REG_GAIN_CAL, 0x00800000);
	//set(&config->bus, MCP356X_RSV_REG_W_A, 0x00900F00);
	set(&config->bus, MCP356X_RSV_REG_W_A, 0x00900000);

	/*
	{
		uint32_t value;
		uint32_t reg = MCP356X_REG_LOCK;
		get(&config->bus, reg, &value);
		LOG_INF("%s: %08x", MCP356X_REG_tostring(reg), value);
	}
	{
		uint32_t value;
		uint32_t reg = MCP356X_REG_CRC_CFG;
		get(&config->bus, reg, &value);
		LOG_INF("%s: %08x", MCP356X_REG_tostring(reg), value);
	}
	*/

}





void egadc_set_mux(struct mcp356x_config * config, uint32_t mux)
{
	set(&config->bus, MCP356X_REG_MUX, mux);
}














static void drdy_callback(const struct device *port, struct gpio_callback *cb, gpio_port_pins_t pins)
{
	struct mcp356x_config *config = CONTAINER_OF(cb, struct mcp356x_config, drdy_cb);
	//TODO: Why is num_irq inside drdy_callback much higher than num_drdy inside mcp356x_acquisition_thread?
	config->num_irq++;
	k_sem_give(&config->drdy_sem);
}


static void mcp356x_acquisition_thread(struct mcp356x_config * config)
{
	LOG_INF("mcp356x_acquisition_thread started!");
	config->status = EGADC_THREAD_STARTED_BIT;
	while (true)
	{
		int rv = 0;

		// Wait for IRQ callback to give this semaphore:
		rv = k_sem_take(&config->drdy_sem, K_SECONDS(12));
		if(rv != 0)
		{
			LOG_ERR("mcp356x_acquisition_thread: k_sem_take: %i\n", rv);
			config->status = EGADC_TIMEOUT_BIT;
			continue;
		}
		
		config->num_drdy++;
		
		// Read ADC value in MCP356X register MCP356X_REG_ADC_DATA as DATA_FORMAT=11:
		int32_t value = 0;
		uint8_t channel = 0;
		rv = get_data_11(&config->bus, &value, &channel);
		if (rv)
		{
			LOG_ERR("mcp356x_acquisition_thread error: get_data_11:%i\n", rv);
			continue;
		}

		// Protect array bounds
		if (channel >= MCP356X_CHANNEL_COUNT)
		{
			LOG_ERR("mcp356x_acquisition_thread error: channel out of bounds:%i\n", channel);
			continue;
		}

		int32_t gain_reg = config->gain_reg;
		if(config->is_scan)
		{
			switch (channel)
			{
			case MCP356X_CH_OFFSET  : gain_reg = MCP356X_CFG_2_GAIN_X_1; break;
			case MCP356X_CH_VCM     : gain_reg = MCP356X_CFG_2_GAIN_X_1; break;
			case MCP356X_CH_AVDD    : gain_reg = MCP356X_CFG_2_GAIN_X_033; break;
			case MCP356X_CH_TEMP    : gain_reg = MCP356X_CFG_2_GAIN_X_1; break;
			case MCP356X_CH_DIFF_D  : gain_reg = MCP356X_CFG_2_GAIN_X_1; break;
			case MCP356X_CH_DIFF_C  : gain_reg = MCP356X_CFG_2_GAIN_X_1; break;
			case MCP356X_CH_DIFF_B  : gain_reg = MCP356X_CFG_2_GAIN_X_1; break;
			case MCP356X_CH_DIFF_A  : gain_reg = MCP356X_CFG_2_GAIN_X_1; break;
			case MCP356X_CH_CH7     : gain_reg = MCP356X_CFG_2_GAIN_X_1; break;
			case MCP356X_CH_CH6     : gain_reg = MCP356X_CFG_2_GAIN_X_1; break;
			case MCP356X_CH_CH5     : gain_reg = MCP356X_CFG_2_GAIN_X_1; break;
			case MCP356X_CH_CH4     : gain_reg = MCP356X_CFG_2_GAIN_X_1; break;
			case MCP356X_CH_CH3     : gain_reg = MCP356X_CFG_2_GAIN_X_1; break;
			case MCP356X_CH_CH2     : gain_reg = MCP356X_CFG_2_GAIN_X_1; break;
			case MCP356X_CH_CH1     : gain_reg = MCP356X_CFG_2_GAIN_X_1; break;
			case MCP356X_CH_CH0     : gain_reg = MCP356X_CFG_2_GAIN_X_1; break;
			default:
				break;
			}
		}

		int32_t mv = MCP356X_raw_to_millivolt(value, config->vref_mv, gain_reg);
		// https://dsp.stackexchange.com/questions/66171/single-pole-iir-filter-fixed-point-design
		// efficient implementation of IIR1 alpha = 1/2:
		config->mv_iir[channel] = (config->mv_iir[channel] + mv) >> 1;
		config->mv_max[channel] = MAX(config->mv_max[channel], mv);
		config->mv_min[channel] = MIN(config->mv_min[channel], mv);
	}
}


int egadc_setup_board(struct mcp356x_config * config)
{
	LOG_INF("Configuring port %s %i",config->irq.port->name, config->irq.pin);
	int err;
	err = gpio_pin_configure_dt(&config->irq, GPIO_INPUT);
	if (err) {return err;}
	err = gpio_pin_interrupt_configure_dt(&config->irq, GPIO_INT_EDGE_TO_ACTIVE);
	if (err) {return err;}
	gpio_init_callback(&config->drdy_cb, drdy_callback, BIT(config->irq.pin));
	err = gpio_add_callback(config->irq.port, &config->drdy_cb);
	if (err) {return err;}
	k_sem_init(&config->acq_sem, 0, 1);
	k_sem_init(&config->drdy_sem, 0, 1);
	k_thread_create(&config->thread, config->stack,
			ADC_MCP356X_ACQUISITION_THREAD_STACK_SIZE,
			(k_thread_entry_t)mcp356x_acquisition_thread,
			(void *)config, NULL, NULL,
			//K_PRIO_COOP(ADC_MCP356X_ACQUISITION_THREAD_PRIO),
			ADC_MCP356X_ACQUISITION_THREAD_PRIO,
			//0,
			0, K_NO_WAIT);
	k_thread_name_set(&config->thread, "mcp356x");
	return 0;
}



void egadc_adc_value_reset(struct mcp356x_config * config)
{
	config->num_drdy = 0;
	config->num_irq = 0;
	config->mv_max[MCP356X_CH_CH0] = INT32_MIN; // Reset max
	config->mv_min[MCP356X_CH_CH0] = INT32_MAX; // Reset min
	config->mv_max[MCP356X_CH_CH0] = INT32_MIN; // Reset max
}
```
